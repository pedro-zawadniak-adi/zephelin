## sample.yaml
```
sample:
  name: memory_profiling
common:
  tags: profiling
tests:
  sample.trace.memory_profiling:
    tags: profiling
    harness: console
    harness_config:
      type: one_line
      regex:
        - "Counter: 5"
        - "zpl_memory_event stack \\(0x[0-9a-f]+\\) \\d+B \\d+B"
        - "zpl_memory_event heap \\(0x[0-9a-f]+\\) \\d+B \\d+B"
        - "zpl_memory_event k_heap \\(0x[0-9a-f]+\\) \\d+B \\d+B"
        - "zpl_memory_event mem_slab \\(0x[0-9a-f]+\\) \\d+B \\d+B"
        - "Counter: 4"
        - "zpl_memory_event stack \\(0x[0-9a-f]+\\) \\d+B \\d+B"
        - "zpl_memory_event heap \\(0x[0-9a-f]+\\) \\d+B \\d+B"
        - "zpl_memory_event k_heap \\(0x[0-9a-f]+\\) \\d+B \\d+B"
        - "zpl_memory_event mem_slab \\(0x[0-9a-f]+\\) \\d+B \\d+B"
        - "Counter: 1"
        - "zpl_memory_event stack \\(0x[0-9a-f]+\\) \\d+B \\d+B"
        - "zpl_memory_event heap \\(0x[0-9a-f]+\\) \\d+B \\d+B"
        - "zpl_memory_event k_heap \\(0x[0-9a-f]+\\) \\d+B \\d+B"
        - "zpl_memory_event mem_slab \\(0x[0-9a-f]+\\) \\d+B \\d+B"
    extra_configs:
      - CONFIG_TRACING_BUFFER_SIZE=4096
  sample.trace.memory_profiling.plaintext.robot:
    tags: profiling
    harness: robot
    harness_config:
      robot_testsuite: memory_profiling.robot
    extra_configs:
      - CONFIG_TRACING_BUFFER_SIZE=4096
  sample.trace.memory_profiling.ctf.robot:
    tags: profiling
    harness: robot
    harness_config:
      robot_testsuite: memory_profiling_ctf.robot
    extra_configs:
      - CONFIG_TRACING_BUFFER_SIZE=4096
      - CONFIG_ZPL_TRACE_FORMAT_CTF=y
  sample.trace.memory_profiling.uart_conf.robot:
    tags: profiling
    harness: robot
    harness_config:
      robot_testsuite: memory_profiling_uart_conf.robot
    extra_configs:
      - CONFIG_ZPL_MEMORY_USAGE_TRACE=n
      - CONFIG_ZPL_RUNTIME_CONFIG_UART=y
  sample.trace.memory_profiling.debug_conf.robot:
    tags: profiling
    harness: robot
    harness_config:
      robot_testsuite: memory_profiling_debug_conf.robot
    extra_configs:
      - CONFIG_ZPL_MEMORY_USAGE_TRACE=n
      - CONFIG_ZPL_RUNTIME_CONFIG_DEBUG=y
  sample.trace.memory_profiling.none_conf.robot:
    tags: profiling
    harness: robot
    harness_config:
      robot_testsuite: memory_profiling_none_conf.robot
    extra_configs:
      - CONFIG_ZPL_MEMORY_USAGE_TRACE=n
      - CONFIG_ZPL_RUNTIME_CONFIG_NONE=y
```

## prj.conf
```kconfig
CONFIG_SYS_HEAP_ARRAY_SIZE=4
CONFIG_HEAP_MEM_POOL_SIZE=256

CONFIG_ZPL_MEMORY_PROFILING_INTERVAL=200
CONFIG_ZPL_MEMORY_PROFILING=y
CONFIG_ZPL=y
CONFIG_ZPL_TRACE=y
```

## src/main.c
```c
#include <zephyr/sys/printk.h>
#include <zephyr/kernel.h>
#include <zpl/lib.h>

K_MEM_SLAB_DEFINE(test_mem_slab, 256, 32, 4);
K_HEAP_DEFINE(test_k_heap, 1024);

void recursive_function(int counter)
{
	char *block_ptr;
	if (k_mem_slab_alloc(&test_mem_slab, (void **)&block_ptr, K_MSEC(100)) == 0) {
		memset(block_ptr, 0, 100);
	}
	int *k_heap_variable = k_heap_alloc(&test_k_heap, 7, K_MSEC(100));
	int *heap_variable = k_malloc(sizeof(int) * 5);

	printk("Counter: %d\n", counter);
	if (counter > 0) {
		k_msleep(200);
		recursive_function(counter - 1);
	}
	k_free(heap_variable);
	k_heap_free(&test_k_heap, k_heap_variable);
	k_mem_slab_free(&test_mem_slab, block_ptr);
}

int main(void)
{
	zpl_init();
	recursive_function(5);
	return 0;
}
```
