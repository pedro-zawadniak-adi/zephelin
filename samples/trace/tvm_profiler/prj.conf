## CMakeLists.txt
```
cmake_minimum_required(VERSION 3.20.0)

find_package(Zephyr REQUIRED HINTS $ENV{ZEPHYR_BASE})
project(app)
target_sources(app PRIVATE src/main.c src/model.c src/platform.c src/magic_wand.c)
include_directories("${CMAKE_CURRENT_BINARY_DIR}/src" "${CMAKE_CURRENT_SOURCE_DIR}/src")

# generate header with model data

set(model_path_graph "${CMAKE_CURRENT_LIST_DIR}/model/magic-wand-graph.json")
set(model_path_params "${CMAKE_CURRENT_LIST_DIR}/model/magic-wand-params.bin")

add_custom_command(
  OUTPUT
    model_graph_min.json
  DEPENDS
    ${model_path_graph}
  COMMAND
    cat ${model_path_graph} |
      tr -d \"\\n\\t \" 1>model_graph_min.json
)

add_custom_command(
  OUTPUT
    src/generated/model_data_graph.h
    src/generated/model_data_params.h
  DEPENDS
    model_graph_min.json
    ${model_path_params}
  COMMAND
    cp model_graph_min.json model_data_graph
  COMMAND
    xxd -i model_data_graph src/generated/model_data_graph.h
  COMMAND
    rm model_data_graph
  COMMAND
    sed -i -e "'s/unsigned/const unsigned/g'"
      src/generated/model_data_graph.h
  COMMAND
    sed -i -e "'s/const unsigned char/const unsigned char __attribute((aligned(32)))/g'"
      src/generated/model_data_graph.h
  COMMAND
    cp ${model_path_params} model_data_params
  COMMAND
    xxd -i model_data_params src/generated/model_data_params.h
  COMMAND
    rm model_data_params
  COMMAND
    sed -i -e "'s/unsigned/const unsigned/g'"
      src/generated/model_data_params.h
  COMMAND
    sed -i -e "'s/const unsigned char/const unsigned char __attribute((aligned(32)))/g'"
      src/generated/model_data_params.h
)

add_custom_target(
  generate_model_data_h
  DEPENDS
    src/generated/model_data_graph.h
    src/generated/model_data_params.h
)

add_dependencies(app generate_model_data_h)
```

## sample.yaml
```
sample:
  name: simple
common:
  tags: profiling
  harness: console
  harness_config:
    type: one_line
    regex:
      - "zpl_tvm_enter_event: op_idx=3 tag=tvmgen_default_fused_nn_conv2d_add_nn_relu"
      - "zpl_tvm_exit_event: op_idx=3 tag=tvmgen_default_fused_nn_conv2d_add_nn_relu"
tests:
  sample.trace.tvm_profiler.plaintext:
    tags: profiling
  sample.trace.tvm_profiler.plaintext.robot:
    tags: profiling
    harness: robot
    harness_config:
      robot_testsuite: tvm_profiler_plaintext.robot
  sample.trace.tvm_profiler.ctf.robot:
    tags: profiling
    extra_configs:
      - CONFIG_ZPL_TRACE_FORMAT_PLAINTEXT=n
      - CONFIG_TRACING_TEST=n
      - CONFIG_TRACING_CTF=y
    harness: robot
    harness_config:
      robot_testsuite: tvm_profiler_ctf.robot
```

## prj.conf
```kconfig
CONFIG_ZPL=y
CONFIG_ZPL_TRACE=y
CONFIG_ZPL_TRACE_FORMAT_PLAINTEXT=y
CONFIG_ZPL_TVM_EVENTS=y
CONFIG_ZPL_TVM_PROFILER=y

# This should be moved to Kconfig when tracing format choice has a symbol in Zephyr
CONFIG_TRACING_TEST=y
CONFIG_TRACING_BUFFER_SIZE=4096
CONFIG_TRACING_SYNC=y
CONFIG_MAIN_STACK_SIZE=3072

CONFIG_TIMING_FUNCTIONS=y
CONFIG_TEST_RANDOM_GENERATOR=y
CONFIG_ZEPHYR_TVM_MODULE=y
CONFIG_ZEPHYR_DLPACK_MODULE=y
```

## src/main.c
```c
#include <zpl/lib.h>

#include <zephyr/kernel.h>
#include <zephyr/random/random.h>
#include <generated/model_data_graph.h>
#include <generated/model_data_params.h>
#include <model.h>

#define N_SAMPLES 10
#define INPUT_SHAPE_0 128
#define INPUT_SHAPE_1 3
#define INPUT_MIN_VAL -2040.0f
#define INPUT_MAX_VAL 2040.0f

void rand_input(float model_input[][INPUT_SHAPE_1]);

int main(void)
{
	int status = 0;
	float __attribute((aligned(32))) model_input[INPUT_SHAPE_0][INPUT_SHAPE_1];

	zpl_init();

	status = model_init();
	if (status) {
		printk("Model init failed %d\n", status);
		return 1;
	}

	status = model_load(model_data_graph, model_data_graph_len, model_data_params, model_data_params_len);
	if (status) {
		printk("Model load failed %d\n", status);
		return 1;
	}

	for (int batch_index = 0; batch_index < N_SAMPLES; ++batch_index) {
		rand_input(model_input);
		status = model_load_input((uint8_t *)model_input, sizeof(float) * INPUT_SHAPE_0 * INPUT_SHAPE_1);
		if (status) {
			printk("Model load input failed %d\n", status);
			break;
		}

		status = model_run();
		if (status) {
			printk("Model run failed %d\n", status);
			break;
		}
	}

	return 0;
}

void rand_input(float model_input[][INPUT_SHAPE_1])
{
	for (int i = 0; i < INPUT_SHAPE_0; ++i) {
		for (int j = 0; j < INPUT_SHAPE_1; ++j) {
			model_input[i][j] = (
				(INPUT_MAX_VAL - INPUT_MIN_VAL) * (float)sys_rand32_get() / (float)0xFFFFFFFF
			) + INPUT_MIN_VAL;
		}
	}
}
```

## src/model.c
```c
#include <tvm/runtime/c_backend_api.h>
#include <tvm/runtime/crt/crt.h>
#include <tvm/runtime/crt/graph_executor.h>
#include <tvm/runtime/crt/internal/graph_executor/graph_executor.h>
#include <dlpack/dlpack.h>
#include <zpl/tvm_profiler.h>
#include "model.h"
#include "magic_wand.h"

extern TVMProfiler tvm_profiler;

static uint8_t __attribute__((aligned(32))) gp_tvmInputBuffer[TVM_INPUT_BUFFER_SIZE * 1024];

static const DLDevice g_device = {kDLCPU, 1};
static TVMGraphExecutor *gp_tvm_graph_executor = NULL;
static TVMModuleHandle g_tvm_module_handle;

int model_init(void)
{
    return TVMInitializeRuntime();
}
int model_load(const uint8_t *model_graph, uint32_t model_graph_size, const uint8_t *model_params, uint32_t model_params_size)
{
    int status = 0;

    do {
        const TVMModule *tvm_module = TVMSystemLibEntryPoint();
        if (NULL == tvm_module)
        {
            status = 1;
            break;
        }

        status = TVMModCreateFromCModule(tvm_module, &g_tvm_module_handle);
        if (status){
            break;
        }

        status = TVMGraphExecutor_Create(model_graph, g_tvm_module_handle, &g_device,
                                         &gp_tvm_graph_executor);
        if (status){
            break;
        }

        status = TVMGraphExecutor_LoadParams(gp_tvm_graph_executor, model_params,
                                             model_params_size);
        if (status){
            break;
        }
    } while(0);

    return status;
}
int model_load_input(const uint8_t *input, uint32_t input_size)
{
    DLTensor tensor_in;

    tensor_in.device = g_device;
    tensor_in.ndim = 4;
    tensor_in.dtype.code = kDLFloat;
    tensor_in.dtype.bits = 32;
    tensor_in.dtype.lanes = 0;
    uint64_t shape[4] = {1, 128, 3, 1};
    tensor_in.shape = shape;
    tensor_in.strides = NULL;
    tensor_in.byte_offset = 0;

    tensor_in.data = (void *)gp_tvmInputBuffer;

    // TVM does not allow setting input by index, so we need to retrieve its name
    uint32_t input_node_id = gp_tvm_graph_executor->input_nodes[0];
    char *input_name = gp_tvm_graph_executor->nodes[input_node_id].name;

    TVMGraphExecutor_SetInput(gp_tvm_graph_executor, input_name, &tensor_in);
    return 0;
}
int model_run(void)
{
    TVMGraphExecutor_Run(gp_tvm_graph_executor, &tvm_profiler);

    zpl_tvm_profiler_dump_events();
    return 0;
}
```
