## sample.yaml
```
sample:
  name: simple
common:
  tags: profiling
  harness: console
  harness_config:
    type: one_line
    regex:
      - "zpl_tflm_enter_event"
tests:
  sample.trace.tflm_events.plaintext:
    tags: profiling
  sample.trace.tflm_events.plaintext.robot:
    tags: profiling
    harness: robot
    harness_config:
      robot_testsuite: tflm_events_plaintext.robot
  sample.trace.tflm_events.ctf.robot:
    tags: profiling
    extra_configs:
      - CONFIG_ZPL_TRACE_FORMAT_CTF=y
    harness: robot
    harness_config:
      robot_testsuite: tflm_events_ctf.robot
```

## prj.conf
```kconfig
CONFIG_ZPL=y
CONFIG_ZPL_TRACE=y
CONFIG_ZPL_TRACE_FORMAT_PLAINTEXT=y
CONFIG_ZPL_TFLM_EVENTS=y
```

## src/main.c
```c
#include <zpl/lib.h>
#include <zpl/tflm_events.h>
#include <zephyr/kernel.h>
#include <stdio.h>

int main(void)
{
	const char *tflm_op_tag = "TFLM_OP";

	zpl_init();

	zpl_emit_tflm_enter_event(k_cycle_get_32(), 0, 0, tflm_op_tag, 0, 1);
	zpl_emit_tflm_exit_event(k_cycle_get_32(), 0, 0, tflm_op_tag, 2, 3);

	return 0;
}
```
