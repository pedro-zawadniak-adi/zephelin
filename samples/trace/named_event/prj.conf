## sample.yaml
```
sample:
  name: simple
common:
  tags: profiling
  harness: console
  harness_config:
    type: one_line
    regex:
      - "zpl_named_event"
tests:
  sample.trace.named_event.plaintext:
    tags: profiling
  sample.trace.named_event.plaintext.robot:
    tags: profiling
    harness: robot
    harness_config:
      robot_testsuite: named_event_plaintext.robot
  sample.trace.named_event.ctf.robot:
    tags: profiling
    extra_configs:
      - CONFIG_ZPL_TRACE_FORMAT_CTF=y
    harness: robot
    harness_config:
      robot_testsuite: named_event_ctf.robot
  sample.trace.named_event.trivial_uart.robot:
    tags: profiling
    platform_allow:
      - max78002evkit/max78002/m4
    extra_configs:
      - CONFIG_ZPL_TRACE_BACKEND_TRIVIAL_UART=y
    harness: robot
    harness_config:
      robot_testsuite: named_event_plaintext_trivial_uart.robot
  sample.trace.named_event.usb:
    tags: profiling
    platform_allow:
      - stm32f429i_disc1/stm32f429xx
    build_only: true
    extra_configs:
      - CONFIG_ZPL_TRACE_BACKEND_USB=y
  sample.trace.named_event.debugger:
    tags: profiling
    extra_configs:
      - CONFIG_ZPL_TRACE_BACKEND_DEBUGGER=y
      - CONFIG_RAM_TRACING_BUFFER_SIZE=10240
    harness: robot
    harness_config:
      robot_testsuite: named_event_plaintext_debugger.robot
```

## prj.conf
```kconfig
CONFIG_ZPL=y
CONFIG_ZPL_TRACE=y
CONFIG_ZPL_TRACE_FORMAT_PLAINTEXT=y

# This should be moved to Kconfig when tracing format choice has a symbol in Zephyr
CONFIG_TRACING_TEST=y
```

## src/main.c
```c
#include <zephyr/kernel.h>
#include <zpl/lib.h>

int main(void)
{
	zpl_init();

	for (int i = 0; i < 100; i++) {
		sys_trace_named_event("counter_value", i, 0);
		k_sleep(K_SECONDS(1));
	}

	return 0;
}
```
