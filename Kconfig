## boards/adi/max32690fthr_custom/board.yml
```yaml
# Copyright (c) 2023-2024 Analog Devices, Inc.
# SPDX-License-Identifier: Apache-2.0

board:
  name: max32690fthr_custom
  full_name: MAX32690FTHR
  vendor: adi
  socs:
    - name: max32690
```

## samples/trace/tflm_instrumentation/sample.yaml
```yaml
sample:
  description: Hello World TensorFlow instrumentation sample
  name: hello world tensorflow instrumentation
common:
  tags: tensorflow profiling
  modules:
    - tflite-micro
  harness: console
  harness_config:
    type: multi_line
    ordered: false
    regex:
      - "x_value:.*, y_value:.*"
      - ""
tests:
  sample.tensorflow.helloworld:
    tags: tensorflow profiling
    filter: CONFIG_FULL_LIBC_SUPPORTED
  sample.tensorflow.helloworld.instrumentation.robot:
    tags: profiling
    harness: robot
    harness_config:
      robot_testsuite: instrumentation.robot
```

## tests/lib/basic/testcase.yaml
```yaml
common:
  tags: profiling
  integration_platforms:
    - qemu_cortex_m0
tests:
  zpl.lib.init: {}
  zpl.lib.init.usb:
    extra_args:
      - EXTRA_CFLAGS=-DCONFIG_ZPL_TRACE_BACKEND_USB
```

## west.yml
```yaml
manifest:
  self:
    west-commands: west/west-commands.yml

  group-filter: [+optional]
  remotes:
    - name: zephyrproject-rtos
      url-base: https://github.com/zephyrproject-rtos
    - name: antmicro
      url-base: https://github.com/antmicro
```

## zpl/Kconfig
```kconfig
config ZPL
	bool "Support for Zephyr Profiling Library"
	help
	  Say 'Y' if you want to enable support for the Zephyr Profiling
	  Library.

config ZPL_TRACE
	bool "Support for integration with Zephyr tracing subsystem"
	select TRACING

choice
	prompt "Zephyr Profiling Library trace format"
	default ZPL_TRACE_FORMAT_PLAINTEXT
	depends on ZPL_TRACE

config ZPL_TRACE_FORMAT_PLAINTEXT
	bool "Plaintext format for Zephyr Profiling Library trace"

config ZPL_TRACE_FORMAT_CTF
	bool "CTF format for Zephyr Profiling Library trace"

endchoice

choice TRACING_FORMAT_CHOICE
	default TRACING_TEST if ZPL_TRACE_FORMAT_PLAINTEXT
	default TRACING_CTF if ZPL_TRACE_FORMAT_CTF
endchoice

choice
	prompt "Zephyr Profiling Library trace backend"
	default ZPL_TRACE_BACKEND_UART
	depends on ZPL_TRACE

config ZPL_TRACE_BACKEND_UART
	bool "UART backend for Zephyr Profiling Library"
	select UART

config ZPL_TRACE_BACKEND_TRIVIAL_UART
	bool "Trivial UART backend for Zephyr Profiling Library"
	select UART

config ZPL_TRACE_BACKEND_USB
	bool "USB backend for Zephyr Profiling Library"
	select GPIO
	select TRACING_HANDLE_HOST_CMD
	select USB_DEVICE_STACK

endchoice

config TRACING_BACKEND_NAME
	string
	default "tracing_backend_uart" if ZPL_TRACE_BACKEND_UART
	default "tracing_backend_trivial_uart" if ZPL_TRACE_BACKEND_TRIVIAL_UART
	default "tracing_backend_usb" if ZPL_TRACE_BACKEND_USB

choice TRACING_BACKEND_CHOICE
	default TRACING_BACKEND_UART if ZPL_TRACE_BACKEND_UART
	default TRACING_BACKEND_USB if ZPL_TRACE_BACKEND_USB
endchoice

config USB_DEVICE_VID
	# ZEPHYR USB-DEV
	default 0x2FE9 if ZPL_TRACE_BACKEND_USB

config ZPL_TRACE_CTF_MAX_STR_LEN
	int "Maximum string length for CTF events"
	default 20
	depends on ZPL_TRACE_FORMAT_CTF

config ZPL_TRACE_CTF_MAX_LONG_STR_LEN
	int "Maximum long string length for CTF events"
	default 60
	depends on ZPL_TRACE_FORMAT_CTF

config ZPL_MEMORY_PROFILING
	bool "Memory profiling"
	depends on ZPL
	depends on SYS_HEAP_ARRAY_SIZE > 0
	select SYS_HEAP_RUNTIME_STATS
	select THREAD_STACK_INFO
	select THREAD_MONITOR
	select INIT_STACKS
	help
	  Say 'Y' if you want to enable support for the Memory Profiling.

config ZPL_MEMORY_PROFILING_INTERVAL
	int "Memory profiling interval in milli seconds"
	default 1000
	depends on ZPL_MEMORY_PROFILING

config ZPL_MEMORY_PROFILING_THREAD_STACK_SIZE
	int "Memory profiling thread stack size in bytes"
	default 512
	depends on ZPL_MEMORY_PROFILING

config ZPL_MEMORY_PROFILING_THREAD_PRIORITY
	int "Memory profiling thread priority"
	default 5
	depends on ZPL_MEMORY_PROFILING

config ZPL_MEMORY_PROFILING_THREAD_DELAY
	int "Memory profiling thread delay"
	default 0
	depends on ZPL_MEMORY_PROFILING

config ZPL_TFLM_EVENTS
	bool "Enables TFLite Micro events"
	depends on ZPL

config ZPL_TFLM_PROFILER
	bool "Build with TFLM profiler support"
	depends on ZPL_TFLM_EVENTS
	depends on TENSORFLOW_LITE_MICRO
	depends on CPP
	depends on STD_CPP17

config ZPL_TFLM_PROFILER_MAX_EVENTS
	int "Maximum number of stored events"
	default 32
	depends on ZPL_TFLM_PROFILER

choice
	prompt "Zephyr Profiling Library trace mode"
	default ZPL_TRACE_LAYER_PROFILING_MODE
	depends on ZPL_TRACE

config ZPL_TRACE_MINIMAL_MODE
	bool "Extremely lightweight profiling mode with no persistent trace"
	imply ZPL_MEMORY_USAGE_TRACE

config ZPL_TRACE_LAYER_PROFILING_MODE
	bool "Layer-level timing with optional runtime hooks"
	imply ZPL_MEMORY_USAGE_TRACE

config ZPL_TRACE_FULL_MODE
	bool "Full profiling mode that enables complete CTF tracing"
	imply ZPL_MEMORY_USAGE_TRACE
	imply TRACING_SYSCALL
	imply TRACING_THREAD
	imply TRACING_WORK
	imply TRACING_ISR
	imply TRACING_SEMAPHORE
	imply TRACING_MUTEX
	imply TRACING_CONDVAR
	imply TRACING_QUEUE
	imply TRACING_FIFO
	imply TRACING_LIFO
	imply TRACING_STACK
	imply TRACING_MESSAGE_QUEUE
	imply TRACING_MAILBOX
	imply TRACING_PIPE
	imply TRACING_HEAP
	imply TRACING_MEMORY_SLAB
	imply TRACING_TIMER
	imply TRACING_EVENT
	imply TRACING_POLLING
	imply TRACING_PM
	imply TRACING_NETWORKING
	imply TRACING_NET_SOCKETS
	imply TRACING_NET_CORE
	imply TRACING_GPIO
	imply TRACING_IDLE

endchoice

config ZPL_MEMORY_USAGE_TRACE
	bool "Enables memory usage traces"

config ZPL_TVM_EVENTS
	bool "Enables micro TVM events"
	depends on ZPL

config ZPL_TVM_PROFILER
	bool "Enables micro TVM profiler"
	depends on ZPL

config ZPL_TVM_PROFILER_MAX_EVENTS
	int "Max number of buffered event"
	default 32
	depends on ZPL_TVM_PROFILER
```
